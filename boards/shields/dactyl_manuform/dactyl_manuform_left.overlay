#include "dactyl_manuform.dtsi" // Notice that the main dtsi files are included in the overlay.

&kscan0 {
    col-gpios
        = <&pro_micro 1 (GPIO_ACTIVE_LOW | GPIO_PULL_UP)> // col1 in the schematic
        , <&pro_micro 5 (GPIO_ACTIVE_LOW | GPIO_PULL_UP)> // col2 in the schematic
        , <&pro_micro 6 (GPIO_ACTIVE_LOW | GPIO_PULL_UP)> // col2 in the schematic
        , <&pro_micro 7 (GPIO_ACTIVE_LOW | GPIO_PULL_UP)> // col3 in the schematic
        , <&pro_micro 8 (GPIO_ACTIVE_LOW | GPIO_PULL_UP)> // col4 in the schematic
        , <&pro_micro 9 (GPIO_ACTIVE_LOW | GPIO_PULL_UP)> // col5 in the schematic
        ;
};
